## main/Kconfig.projbuild
```kconfig
menu "EH3D HMI"
    config HMI_HW_STOP_GPIO
        int "GPIO of the hardware stop input (-1: not wired)"
        default -1
        help
            The stop button is wired to this input AND cuts the machine's drive by itself, independent of this screen. The screen only
            reads it to show the state and to refuse moves while it is pressed. Check the pin against the schematic of the module.
    config HMI_HW_STOP_ACTIVE_LOW
        bool "The stop input is active low"
        default y
    config HMI_CONFIG_PATH
        string "Settings file in the config partition"
        default "/config/hmi.cfg"
    config HMI_STACK_REPORT_S
        int "Seconds between the reports of the stack each task has left (0: never)"
        default 60
        range 0 3600
    config HMI_STACK_WARN_BYTES
        int "Warn when a task has less stack than this left"
        default 512
        range 64 8192
endmenu
```
